VERSION ""

NS_ :

BS_:

BU_: Motor Batterie Fahrzeug

BO_ 256 Motor: 8 Motor
 SG_ Drehzahl : 0|16@1+ (0.25,0) [0|16000] "rpm" Vector__XXX
 SG_ Kuehlmittel : 16|8@1+ (1,-40) [-40|215] "degC" Vector__XXX

BO_ 512 Batterie: 8 Batterie
 SG_ Spannung : 7|16@0+ (0.01,0) [0|655.35] "V" Vector__XXX
 SG_ Strom : 16|16@1- (0.1,0) [-3276.8|3276.7] "A" Vector__XXX

BO_ 2566844672 Fahrzeug: 8 Fahrzeug
 SG_ Geschwindigkeit : 8|16@1+ (0.00390625,0) [0|250] "km/h" Vector__XXX

BO_ 768 Zellen: 16 Batterie
 SG_ Zelle_min : 0|16@1+ (0.001,0) [0|5] "V" Vector__XXX
 SG_ Zelle_max : 16|16@1+ (0.001,0) [0|5] "V" Vector__XXX

CM_ SG_ 256 Drehzahl "Motordrehzahl";
