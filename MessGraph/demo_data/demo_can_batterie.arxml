AUTOSAR XML (schema 4.0)
standard types defined: float
package /Batterie/Cluster
  can cluster CAN
    can physical channel Kanal
      frame Batterie: id 0x200, frame-length=8, can-addressing-mode=STANDARD
        pdu Batterie_Pdu: length=8
          signal Spannung: start 7, 16 bit, big-endian, base-type=uint, compu {phys=raw*0.01; unit V}
          signal Strom: start 16, 16 bit, little-endian, base-type=sint, compu {phys=raw*0.1; unit A}
      frame Zellen: id 0x300, frame-length=16, can-addressing-mode=STANDARD
        pdu Zellen_Pdu: length=16
          signal Zelle_min: start 0, 16 bit, little-endian, base-type=uint, compu {phys=raw*0.001; unit V}
          signal Zelle_max: start 16, 16 bit, little-endian, base-type=uint, compu {phys=raw*0.001; unit V}
package /Batterie/Units
  unit V: display-name=V
  unit A: display-name=A
package /Batterie/Types
  base type uint: base-type-encoding=NONE
  base type sint: base-type-encoding=2C
