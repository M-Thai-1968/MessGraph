VERSION ""

NS_ :

BS_:

BU_: Motor Batterie Fahrzeug

BO_ 256 Motor: 8 Motor
 SG_ Drehzahl : 0|16@1+ (0.25,0) [0|16000] "rpm" Vector__XXX
 SG_ Kuehlmittel : 16|8@1+ (1,-40) [-40|215] "degC" Vector__XXX

BO_ 2566844672 Fahrzeug: 8 Fahrzeug
 SG_ Geschwindigkeit : 8|16@1+ (0.00390625,0) [0|250] "km/h" Vector__XXX
